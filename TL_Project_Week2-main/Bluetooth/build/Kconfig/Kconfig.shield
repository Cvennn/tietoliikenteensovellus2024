## TL_Project_Week2-main/Bluetooth/build/Kconfig/Kconfig.shield
```kconfig
osource "c:/ncs/nordcodes/tlprojekti/tietoliikenteensovellus2024/tl_project_week2-main/bluetooth/boards/shields/*/Kconfig.shield"
osource "C:/ncs/v2.7.0/nrf/boards/shields/*/Kconfig.shield"
```

## TL_Project_Week2-main/Bluetooth/build/Kconfig/Kconfig.shield.defconfig
```kconfig
osource "c:/ncs/nordcodes/tlprojekti/tietoliikenteensovellus2024/tl_project_week2-main/bluetooth/boards/shields/*/Kconfig.defconfig"
osource "C:/ncs/v2.7.0/nrf/boards/shields/*/Kconfig.defconfig"
```

## TL_Project_Week2-main/Bluetooth/build/hci_ipc/Kconfig/Kconfig.shield
```kconfig
osource "c:/ncs/nordcodes/bt-fund/lesson4/blefund_less4_exer2/boards/shields/*/Kconfig.shield"
osource "C:/ncs/v2.7.0/nrf/boards/shields/*/Kconfig.shield"
```

## TL_Project_Week2-main/Bluetooth/build/hci_ipc/Kconfig/Kconfig.shield.defconfig
```kconfig
osource "c:/ncs/nordcodes/bt-fund/lesson4/blefund_less4_exer2/boards/shields/*/Kconfig.defconfig"
osource "C:/ncs/v2.7.0/nrf/boards/shields/*/Kconfig.defconfig"
```

## TL_Project_Week2-main/Bluetooth/build_1/Bluetooth/Kconfig/Kconfig.shield.defconfig
```kconfig
osource "C:/ncs/nordcodes/TLprojekti/tietoliikenteensovellus2024/TL_Project_Week2-main/Bluetooth/boards/shields/*/Kconfig.defconfig"
osource "C:/ncs/v2.7.0/nrf/boards/shields/*/Kconfig.defconfig"
```

## TL_Project_Week2-main/Bluetooth/build_1/Kconfig/Kconfig.shield
```kconfig
osource "C:/ncs/nordcodes/TLprojekti/tietoliikenteensovellus2024/TL_Project_Week2-main/Bluetooth/boards/shields/*/Kconfig.shield"
osource "C:/ncs/v2.7.0/nrf/boards/shields/*/Kconfig.shield"
```
